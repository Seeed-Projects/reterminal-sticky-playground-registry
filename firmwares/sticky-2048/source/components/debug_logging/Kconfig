## firmwares/sticky-2048/source/components/debug_logging/Kconfig
```kconfig
menu "Application Debug Logging"

    config APP_DEBUG_EPAPER_TOUCH_LOG_ENABLED
        bool "Enable e-paper/touch debug logs"
        default n
        help
            Enable extra debug logs for tracing e-paper and touch stalls.
            Leave disabled for normal builds.

endmenu
```

## integrations/sticky-2048/source/sdkconfig.defaults
```kconfig
CONFIG_IDF_TARGET="esp32s3"
CONFIG_ESPTOOLPY_FLASHSIZE_32MB=y
CONFIG_PARTITION_TABLE_SINGLE_APP_LARGE=y
CONFIG_SPIRAM=y
CONFIG_SPIRAM_MODE_OCT=y
CONFIG_SPIRAM_SPEED_80M=y
CONFIG_ESP_MAIN_TASK_STACK_SIZE=8192
CONFIG_FREERTOS_HZ=1000
CONFIG_GPIO_CTRL_FUNC_IN_IRAM=y
CONFIG_ESP_CONSOLE_SECONDARY_NONE=y
CONFIG_IDF_EXPERIMENTAL_FEATURES=y
# CONFIG_ESP_WIFI_ENABLED is not set
# CONFIG_BT_ENABLED is not set
CONFIG_APP_REPRODUCIBLE_BUILD=y
```
